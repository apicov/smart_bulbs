## firmware/main/Kconfig.projbuild
```kconfig
menu "Pico Bulb"

config BULB_TOPIC_PREFIX
    string "MQTT topic prefix"
    default "pico/bulb"

config BULB_OTA_URL
    string "Firmware image URL"
    default "https://mqtt.apicov.xyz/firmware/pico-bulb.bin"
    help
        Where updates are downloaded from, verified with the built-in CA bundle.
        It's compiled in, so an MQTT message can't point a bulb somewhere else.

config BULB_TIMEZONE
    string "Timezone (POSIX TZ string)"
    default "CET-1CEST,M3.5.0,M10.5.0/3"
    help
        Used for the wake-up alarm. The default is Central European Time with
        automatic daylight saving. For UK time use GMT0BST,M3.5.0/1,M10.5.0.

config BULB_LED_GPIO
    int "LED strip data GPIO"
    default 18
    help
        Avoid strapping pins 4, 5, 8, 9, 15. GPIO8 drives the onboard RGB LED.

config BULB_LED_COUNT
    int "Number of LEDs (tools/provision.py can override this per bulb)"
    range 1 1024
    default 24

config BULB_MAX_MILLIAMPS
    int "Strip current limit in mA, 0 = unlimited (tools/provision.py can override this per bulb)"
    default 1000
    help
        Frames are scaled down so the estimated draw stays below this.
        Size it to your 5V supply.

config BULB_PIR_GPIO
    int "PIR sensor GPIO (-1 = no sensor)"
    default 19

config BULB_POWER_ON_LIGHT
    bool "Turn light on at power-up (wall-switch friendly)"
    default y
    help
        If enabled, the bulb lights up with its last colour/brightness when
        power returns. If disabled, it restores its last on/off state too.
        A restart by the firmware, such as after an update or a crash, always
        restores the last on/off state.

endmenu
```
